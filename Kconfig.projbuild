## Kconfig.projbuild
```kconfig
menu "LVGL Configuration"
    config LVGL_ENABLE_FULL
        bool "Enable full LVGL features"
        default y
        help
            Enable all LVGL features

    config LVGL_COLOR_DEPTH
        int "LVGL color depth"
        default 16
        range 1 32
        help
            Color depth for LVGL

    config LVGL_TICK_RATE_MIN
        int "LVGL minimum tick rate (ms)"
        default 10
        range 1 100
        help
            Minimum tick rate for LVGL

    config LVGL_USING_STATISTICS
        bool "Using LVGL statistics"
        default n
        help
            Enable LVGL statistics

endmenu
```

## sdkconfig.defaults
```kconfig
# ESP-IDF SDK Configuration Defaults
# Wi-Fi включён для веб-сервера

CONFIG_ESP_WIFI_ENABLED=y
CONFIG_BT_ENABLED=n
CONFIG_FREERTOS_HZ=1000

# Flash size: 4MB (Waveshare ESP32-C6-LCD-1.47)
CONFIG_ESPTOOLPY_FLASHSIZE_4MB=y
CONFIG_ESPTOOLPY_FLASHSIZE="4MB"

# Консоль на USB-Serial-JTAG (COM7 на плате Waveshare)
CONFIG_ESP_CONSOLE_USB_SERIAL_JTAG=y

# LVGL: используем lv_conf.h (Kconfig пропускаем)
CONFIG_LV_CONF_SKIP=y
```
